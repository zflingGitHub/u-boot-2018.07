// SPDX-License-Identifier: GPL-2.0+
/*
 * Itop4412 board device tree source
 *
 * Copyright (c) 2014 Samsung Electronics Co., Ltd.
 *		http://www.samsung.com
 */

/dts-v1/;
#include "exynos4412.dtsi"

/ {
	model = "Exynos4412 based on Exynos4412";
	compatible = "samsung,itop4412", "samsung,exynos4412";

	aliases {
		serial0 = "/serial@13820000";
		console = "/serial@13820000";
	};

	serial@13820000 {
		status = "okay";
	};
	
	emmc-reset {
		compatible = "samsung,emmc-reset";
		reset-gpio = <&gpk1 2 0>;
	};
};
